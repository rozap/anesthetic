VERSION ""

NS_ :

BS_:

BU_: DASH ECU

BO_ 420 FUEL_LEVEL: 1 DASH
 SG_ FuelPercentage : 0|8@1+ (1,0) [0|100] "%" ECU

CM_ BO_ 420 "Fuel level percentage message sent from dashboard to ECU";
CM_ SG_ 420 FuelPercentage "Fuel level percentage from 0-100%";
